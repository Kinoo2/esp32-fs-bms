## sdkconfig.defaults
```kconfig
CONFIG_ESPTOOLPY_FLASHSIZE_16MB=y
CONFIG_ESP_SYSTEM_PANIC_PRINT_HALT=y
CONFIG_HEAP_TRACING_STACK_DEPTH=0
CONFIG_HEAP_TRACING_STANDALONE=y
CONFIG_PARTITION_TABLE_CUSTOM=y
CONFIG_PARTITION_TABLE_CUSTOM_FILENAME="partitions.csv"
CONFIG_PARTITION_TABLE_FILENAME="partitions.csv"
CONFIG_ESP_TASK_WDT=n
```
